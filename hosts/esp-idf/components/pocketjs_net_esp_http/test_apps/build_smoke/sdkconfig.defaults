## hosts/esp-idf/components/pocketjs_net_esp_http/test_apps/build_smoke/sdkconfig.defaults
```kconfig
CONFIG_ESP_HTTP_CLIENT_EVENT_POST_TIMEOUT=0
CONFIG_ESP_HTTP_CLIENT_ENABLE_HTTPS=y
# CONFIG_ESP_HTTP_CLIENT_ENABLE_BASIC_AUTH is not set
# CONFIG_ESP_HTTP_CLIENT_ENABLE_DIGEST_AUTH is not set
# CONFIG_ESP_HTTP_CLIENT_SAVE_RESPONSE_HEADERS is not set
CONFIG_MBEDTLS_CERTIFICATE_BUNDLE=y
CONFIG_MBEDTLS_SSL_PROTO_TLS1_2=y
# CONFIG_MBEDTLS_SSL_PROTO_TLS1_3 is not set
# CONFIG_MBEDTLS_SSL_RENEGOTIATION is not set
# CONFIG_MBEDTLS_ALLOW_WEAK_CERTIFICATE_VERIFICATION is not set
# CONFIG_MBEDTLS_CERTIFICATE_BUNDLE_DEPRECATED_LIST is not set
# CONFIG_MBEDTLS_DES_C is not set
# CONFIG_ESP_TLS_INSECURE is not set
```

## hosts/esp-idf/components/pocketjs_net_guest_spike/test_apps/build_smoke/sdkconfig.defaults
```kconfig
CONFIG_COMPILER_OPTIMIZATION_SIZE=y
CONFIG_PARTITION_TABLE_CUSTOM=y
CONFIG_PARTITION_TABLE_CUSTOM_FILENAME="partitions.csv"
CONFIG_ESP_HTTP_CLIENT_EVENT_POST_TIMEOUT=0
# CONFIG_ESP_HTTP_CLIENT_ENABLE_BASIC_AUTH is not set
# CONFIG_ESP_HTTP_CLIENT_ENABLE_DIGEST_AUTH is not set
# CONFIG_ESP_HTTP_CLIENT_SAVE_RESPONSE_HEADERS is not set
```

## hosts/sifli/components/pocketjs_gpu/Kconfig
```kconfig
menuconfig POCKETJS_GPU
    bool "PocketJS GPU command queue (EPIC / VG Lite)"
    default y
    depends on BF0_HCPU
    help
      The C executor behind hosts/sifli/include/pocketjs_gpu.h. Runs the
      renderer's fills, A8 blends, gradients, native texture blits, and CPU
      fallback tile copies on EPIC through the SiFli HAL.

if POCKETJS_GPU

config POCKETJS_GPU_MASK_TILE_KB
    int "A8 plane size per slot (KB, two slots in SRAM)"
    default 64
    range 4 512

config POCKETJS_GPU_CPU_TILE_KB
    int "RGB565 tile size per slot for CPU fallback (KB, two slots in SRAM)"
    default 64
    range 4 512

config POCKETJS_GPU_MAX_TEXTURES
    int "Native texture registry capacity"
    default 32
    range 1 256

config POCKETJS_GPU_MIN_PIXELS
    int "Smallest rectangle (physical pixels) worth a hardware transaction"
    default 64
    range 1 1048576

config POCKETJS_GPU_DIRECT_CPU_WRITES
    bool "Let the renderer write the framebuffer from the CPU"
    default n
    help
      Off keeps every CPU fallback inside SRAM tiles that EPIC copies in and
      out, so the framebuffer stays GPU-only. Turn on only when the
      framebuffer is CPU-writable without cache maintenance and profiling
      shows tile copies cost more than direct writes.

endif
```

## hosts/sifli/components/pocketjs_host/Kconfig
```kconfig
menuconfig POCKETJS_HOST
    bool "PocketJS host (QuickJS guest, framebuffer ring, input)"
    default y
    depends on POCKETJS_GPU && PKG_USING_QUICKJS && BSP_USING_LCD && RT_USING_MEMHEAP
    help
      The reusable firmware host: a bounded PSRAM heap shared by QuickJS and
      the Rust core, the RGB565 framebuffer ring presented through the
      RT-Thread LCD device, board keys and touch mapped to the PocketJS input
      contract, one mounted guest at a time from an embedded catalog, and
      the serial profiler.

if POCKETJS_HOST

config POCKETJS_LOGICAL_WIDTH
    int "Guest viewport width (logical pixels)"
    default 512

config POCKETJS_LOGICAL_HEIGHT
    int "Guest viewport height (logical pixels)"
    default 300

config POCKETJS_RENDER_SCALE
    int "Integer render scale (physical pixels per logical pixel)"
    default 2
    range 1 4

config POCKETJS_RASTER_DENSITY
    int "Raster density the guest assets were baked at"
    default 2
    range 1 4

config POCKETJS_TICK_HZ
    int "Guest frame rate (Hz)"
    default 60
    range 1 120

config POCKETJS_FRAMEBUFFER_COUNT
    int "RGB565 framebuffers in the presentation ring"
    default 3
    range 2 4
    help
      RAM-less DPI panels need three: one scanned, one pending, one being
      rendered. Each framebuffer keeps its own damage tracker.

config POCKETJS_HEAP_KB
    int "Shared QuickJS + Rust heap in cached PSRAM (KB)"
    default 7168

config POCKETJS_QJS_MEMORY_LIMIT_KB
    int "QuickJS runtime memory limit inside the shared heap (KB)"
    default 4096

config POCKETJS_MPU_OVERRIDE
    bool "Override the SDK MPU table: PSRAM1 cached, PSRAM2 non-cacheable"
    default y
    help
      SF32LB58x only (the chip is a compiler define, not a Kconfig symbol;
      host_mpu.c refuses other chips). The framebuffer ring lives in
      PSRAM2. Marking that window normal non-cacheable at startup lets EPIC
      and the LCD controller observe CPU writes without cache maintenance.
      Adding the region later, after the SDK table is live, raises DACCVIOL
      on the first framebuffer write.

config POCKETJS_KEY_LONG_PRESS_MS
    int "Key long-press threshold (ms); 0 keeps level semantics"
    default 0
    help
      0: KEY1/KEY2 levels are reported as LEFT/RIGHT every frame.
      >0: a key emits one LEFT/RIGHT pulse on release; holding KEY2 on the
      launcher emits one CIRCLE pulse, holding KEY1 in a guest returns to
      the launcher.

config POCKETJS_INPUT_TOUCH
    bool "Forward touch contacts to the guest"
    default y
    depends on BSP_USING_TOUCHD

config POCKETJS_NATIVE_TEXTURE_STAGING
    bool "Copy native texture blobs into the heap before registering them"
    default y
    help
      Native (.epic) blobs are linked into code rodata. Copying them into
      the cached PSRAM heap once per guest mount keeps EPIC reads on the
      data bus.

config POCKETJS_PROFILE
    bool "Print frame, render, and work statistics once per second"
    default y

endif
```
